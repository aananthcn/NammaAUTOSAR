AUTOSAR XML (schema 4-0-3)
package /Ecuc_RaspberryPi-Pico
  module config Os: ecuc-def-edition=4.2.0, implementation-config-variant=VARIANT-PRE-COMPILE
    3 x OsAppMode:
      OSDEFAULTAPPMODE
      MANUFACT_MODE
      HW_TEST_MODE
    OsOs (OsOS): OsStatus=STANDARD
      OsHooks: OsErrorHook=FALSE, OsPostTaskHook=FALSE, OsPreTaskHook=FALSE, OsShutdownHook=FALSE, OsStartupHook=FALSE, OsProtectionHook=NOT YET SUPPORTED
      OsHookStack: OsHookStackSize=512
      NammaOsekParams (VendorSpecific): OsName=NammaAutosar, CpuName=rp2040, IrqStackSize=512, ContextSaveSize=128, AppTasksSize=3200
    event1 (OsEvent)
    event2 (OsEvent)
    mSecCounter (OsCounter): OsCounterMaxAllowedValue=1000000, OsCounterMinCycle=1, OsCounterTicksPerBase=1, OsCounterType=HARDWARE
    uSecCounter (OsCounter): OsCounterMaxAllowedValue=1000, OsCounterMinCycle=100, OsCounterTicksPerBase=1, OsCounterType=HARDWARE
    RES_MUTEX1 (OsResource): OsResourceProperty=STANDARD
    5 x OsTask, all with OsTaskStackSize=512, OsTaskSchedule=NON:
      Task_A: OsTaskActivation=2, OsTaskPriority=1, OsTaskResourceRef=RES_MUTEX1
        OsTaskAutostart: OsTaskAppModeRef=OSDEFAULTAPPMODE, OsTaskAppModeRef=MANUFACT_MODE, OsTaskAppModeRef=HW_TEST_MODE
      Task_B: OsTaskActivation=1, OsTaskPriority=2, OsTaskEventRef=event1
      Task_C: OsTaskActivation=1, OsTaskPriority=3, OsTaskEventRef=event1, OsTaskEventRef=event2
        OsTaskAutostart: OsTaskAppModeRef=OSDEFAULTAPPMODE
      Task_D: OsTaskActivation=1, OsTaskPriority=4, OsTaskResourceRef=RES_MUTEX1
      EcuM_StartupTwo: OsTaskActivation=1, OsTaskPriority=100
        OsTaskAutostart: OsTaskAppModeRef=OSDEFAULTAPPMODE
    4 x OsAlarm:
      WakeTaskA: OsAlarmCounterRef=mSecCounter
        OsAlarmAction
          ACTIVATETASK (OsAlarmActivateTask): OsAlarmActivateTaskRef=Task_A
        OsAlarmAutostart:
          OsAlarmAlarmTime = 40
          OsAlarmCycleTime = 500
          OsAlarmAutostartType = NOT YET SUPPORTED
          OsAlarmAppModeRef = OSDEFAULTAPPMODE
          OsAlarmAppModeRef = MANUFACT_MODE
      WakeTaskB: OsAlarmCounterRef=mSecCounter
        OsAlarmAction
          SETEVENT (OsAlarmSetEvent): OsAlarmSetEventTaskRef=Task_B, OsAlarmSetEventRef=event1
      uSecAlarm: OsAlarmCounterRef=uSecCounter
        OsAlarmAction
          ALARMCALLBACK (OsAlarmCallback): OsAlarmCallbackName=Alarm_uSecAlarm_callback
      WakeTaskD: OsAlarmCounterRef=mSecCounter
        OsAlarmAction
          ACTIVATETASK (OsAlarmActivateTask): OsAlarmActivateTaskRef=Task_D
        OsAlarmAutostart: OsAlarmAlarmTime=40, OsAlarmCycleTime=1000, OsAlarmAutostartType=NOT YET SUPPORTED, OsAlarmAppModeRef=OSDEFAULTAPPMODE
    SystemTickISR (OsIsr): OsIsrInterruptNumber=4, OsIsrInterruptPriority=0, OsIsrCategory=2, OsIsrStackSize=
  module config Mcu: ecuc-def-edition=4.2.0, implementation-config-variant=VARIANT-PRE-COMPILE
    McuNammaAutosarInfo (VendorSpecific): Micro=rp2040, MicroArch=cortex-m0, MicroMaker=RaspberryPi
  module config Port: ecuc-def-edition=4.2.0, implementation-config-variant=VARIANT-PRE-COMPILE
    PortConfigSet
      PortContainer: PortNumberOfPortPins=7
        7 x PortPin, all with PortPinDirectionChangeable=FALSE, PortPinModeChangeable=FALSE:
          PortPin: PortPinId=4, PortPinDirection=PORT_PIN_OUT, PortPinLevelValue=PORT_PIN_LEVEL_LOW, PortPinMode=PORT_PIN_MODE_LIN, PortPinInitialMode=PORT_PIN_MODE_LIN
          PortPin: PortPinId=5, PortPinDirection=PORT_PIN_IN, PortPinLevelValue=PORT_PIN_LEVEL_LOW, PortPinMode=PORT_PIN_MODE_LIN, PortPinInitialMode=PORT_PIN_MODE_LIN
          PortPin: PortPinId=25, PortPinDirection=PORT_PIN_OUT, PortPinLevelValue=PORT_PIN_LEVEL_LOW, PortPinMode=PORT_PIN_MODE_DIO, PortPinInitialMode=PORT_PIN_MODE_DIO
          PortPin: PortPinId=0, PortPinDirection=PORT_PIN_IN, PortPinLevelValue=PORT_PIN_LEVEL_LOW, PortPinMode=PORT_PIN_MODE_SPI, PortPinInitialMode=PORT_PIN_MODE_SPI
          PortPin: PortPinId=1, PortPinDirection=PORT_PIN_OUT, PortPinLevelValue=PORT_PIN_LEVEL_HIGH, PortPinMode=PORT_PIN_MODE_DIO, PortPinInitialMode=PORT_PIN_MODE_DIO
          PortPin: PortPinId=2, PortPinDirection=PORT_PIN_OUT, PortPinLevelValue=PORT_PIN_LEVEL_LOW, PortPinMode=PORT_PIN_MODE_SPI, PortPinInitialMode=PORT_PIN_MODE_SPI
          PortPin: PortPinId=3, PortPinDirection=PORT_PIN_OUT, PortPinLevelValue=PORT_PIN_LEVEL_LOW, PortPinMode=PORT_PIN_MODE_SPI, PortPinInitialMode=PORT_PIN_MODE_SPI
    PortGeneral: PortDevErrorDetect=TRUE, PortVersionInfoApi=FALSE, PortSetPinDirectionApi=TRUE, PortSetPinModeApi=FALSE
  module config Dio: ecuc-def-edition=4.2.0, implementation-config-variant=VARIANT-PRE-COMPILE
    DioConfig
      DioPort: DioPortId=25
        DioChannel: DioChannelId=25
      DioPort: DioPortId=1
        DioChannel: DioChannelId=1
    DioGeneral: DioDevErrorDetect=FALSE, DioVersionInfoApi=TRUE, DioFlipChannelApi=FALSE, DioMaskedWritePortApi=TRUE
  module config Spi: ecuc-def-edition=4.2.0, implementation-config-variant=VARIANT-PRE-COMPILE
    SpiDriver: SpiMaxChannel=3, SpiMaxJob=2, SpiMaxSequence=2
      3 x SpiChannel, all with SpiChannelType=IB, SpiEbMaxLength=0, SpiIbNBuffers=1, SpiTransferStart=MSB:
        SpiChannel: SpiChannelId=0, SpiDataWidth=8, SpiDefaultData=0x00
        SpiChannel: SpiChannelId=1, SpiDataWidth=8, SpiDefaultData=0x01
        SpiChannel: SpiChannelId=2, SpiDataWidth=16, SpiDefaultData=0xAA55
      SpiExternalDevice:
        SpiBaudrate = 100000.0
        SpiCsIdentifier = CS_Ethernet
        SpiCsPolarity = LOW
        SpiCsSelection = CS_VIA_GPIO
        SpiDataShiftEdge = LEADING
        SpiEnableCs = FALSE
        SpiHwUnit = CSIB0
        SpiShiftClockIdleLevel = LOW
        SpiTimeClk2Cs = 0.0
        SpiTimeCs2Clk = 0.000001
        SpiTimeCs2Cs = 0.000001
        DIO = 1
        SpiFrameFormat = MOTOROLA_SPI
      SpiJob: SpiJobEndNotification=NULL, SpiJobId=0, SpiJobPriority=0, SpiDeviceAssignment=CSIB0
        SpiChannelList: SpiChannelIndex=0, SpiChannelAssignment=Job no: 0
        SpiChannelList: SpiChannelIndex=1, SpiChannelAssignment=Job no: 0
      SpiJob: SpiJobEndNotification=NULL, SpiJobId=1, SpiJobPriority=0, SpiDeviceAssignment=CSIB0
        SpiChannelList: SpiChannelIndex=0, SpiChannelAssignment=Job no: 1
        SpiChannelList: SpiChannelIndex=2, SpiChannelAssignment=Job no: 1
      SpiSequence: SpiInterruptibleSequence=FALSE, SpiSeqEndNotification=NULL, SpiSequenceId=0, SpiSequenceName=SEQ_ETH_2_BYTE
        SpiJobAssignment: SpiJob=0
      SpiSequence: SpiInterruptibleSequence=FALSE, SpiSeqEndNotification=NULL, SpiSequenceId=1, SpiSequenceName=SEQ_ETH_3_BYTE
        SpiJobAssignment: SpiJob=1
    SpiGeneral:
      SpiCancelApi = FALSE
      SpiChannelBuffersAllowed = IB
      SpiDevErrorDetect = FALSE
      SpiHwStatusApi = FALSE
      SpiInterruptibleSeqAllowed = FALSE
      SpiLevelDelivered = 1
      SpiMainFunctionPeriod = 0.01
      SpiSupportConcurrentSyncTransmit = FALSE
      SpiVersionInfoApi = FALSE
    SpiPublishedInformation: SpiMaxHwUnit=1
  module config Lin: ecuc-def-edition=4.2.0, implementation-config-variant=VARIANT-PRE-COMPILE
    LinGeneral: LinIndex=0, LinDevErrorDetect=FALSE, LinVersionInfoApi=FALSE, LinTimeoutDuration=2
    LinGlobalConfig
      LinChannel: LinChannelId=0, LinNodeType=SLAVE, LinChannelBaudRate=1000, LinChannelWakeupSupport=FALSE, LinChannelEcuMWakeupSource=test, LinClockRef=test
  module config Lin: ecuc-def-edition=4.2.0, implementation-config-variant=VARIANT-PRE-COMPILE
    LinGeneral: LinIndex=1, LinDevErrorDetect=TRUE, LinVersionInfoApi=TRUE, LinTimeoutDuration=0
    LinGlobalConfig
      LinChannel: LinChannelId=1, LinNodeType=MASTER, LinChannelBaudRate=1000, LinChannelWakeupSupport=FALSE, LinChannelEcuMWakeupSource=chumma, LinClockRef=chumma
  module config Eth: ecuc-def-edition=4.2.0, implementation-config-variant=VARIANT-PRE-COMPILE
    EthConfigSet
      EthCtrlConfig:
        EthCtrlConfigSwBufferHandling = FALSE
        EthCtrlEnableMii = FALSE
        EthCtrlEnableRxInterrupt = FALSE
        EthCtrlEnableSpiInterface = FALSE
        EthCtrlEnableTxInterrupt = FALSE
        EthCtrlIdx = 0
        EthCtrlMacLayerSpeed = ETH_MAC_LAYER_SPEED_10M
        EthCtrlMacLayerType = ETH_MAC_LAYER_TYPE_XMII
        EthCtrlMacLayerSubType = SERIAL
        EthCtrlPhyAddress = 00:00:5e:00:53:00
        EthCtrlConfigEgress
          EthCtrlConfigEgressFifo:
            EthCtrlConfigEgressFifoBufLenByte = 128
            EthCtrlConfigEgressFifoBufTotal = 100
            EthCtrlConfigEgressFifoIdx = 0
            EthCtrlConfigEgressFifoPriorityAssignment = 7
          EthCtrlConfigScheduler
            EthCtrlConfigSchedulerPredecessor: EthCtrlConfigSchedulerPredecessorOrder=2
          EthCtrlConfigShaper: EthCtrlConfigShaperIdleSlope=1, EthCtrlConfigShaperMaxCredit=1, EthCtrlConfigShaperMinCredit=1
        EthCtrlConfigIngress
          EthCtrlConfigIngressFifo:
            EthCtrlConfigIngressFifoBufLenByte = 128
            EthCtrlConfigIngressFifoBufTotal = 100
            EthCtrlConfigIngressFifoIdx = 0
            EthCtrlConfigIngressFifoPriorityAssignment = 7
        EthCtrlConfigSpiConfiguration:
          EthCtrlConfigSpiChunkPayloadSize = 64
          EthCtrlConfigSpiCommRetries = 1
          EthCtrlConfigSpiCommTimeout = 0.1
          EthCtrlConfigSpiEnableControlDataProtection = FALSE
          EthCtrlConfigSpiEnableRxCSAlign = FALSE
          EthCtrlConfigSpiEnableRxCutThrough = FALSE
          EthCtrlConfigSpiEnableRxZeroAlign = FALSE
          EthCtrlConfigSpiEnableTransmitDataHdrSequence = FALSE
          EthCtrlConfigSpiEnableTxChecksum = FALSE
          EthCtrlConfigSpiEnableTxCutThrough = FALSE
          EthCtrlConfigSpiSelectTimeStamp = FALSE
          EthCtrlConfigSpiTransmitCreditThreshold = 0
          EthCtrlConfigSpiAccessSynchronous = FALSE
          EthCtrlConfigSpiSequenceName = SEQ_ETH_2_BYTE
    EthGeneral:
      EthIndex = 0
      EthDevErrorDetect = FALSE
      EthMainFunctionPeriod = 0.01
      EthGetCounterValuesApi = FALSE
      EthGetRxStatsApi = FALSE
      EthGetTxErrorCounterValuesApi = FALSE
      EthGetTxStatsApi = FALSE
      EthGlobalTimeSupport = FALSE
      EthMaxCtrlsSupported = 2
      EthVersionInfoApi = FALSE
      EthCtrlOffloading:
        EthCtrlEnableOffloadChecksumIPv4 = TRUE
        EthCtrlEnableOffloadChecksumICMP = FALSE
        EthCtrlEnableOffloadChecksumTCP = TRUE
        EthCtrlEnableOffloadChecksumUDP = FALSE
  module config Eth: ecuc-def-edition=4.2.0, implementation-config-variant=VARIANT-PRE-COMPILE
    EthConfigSet
      EthCtrlConfig:
        EthCtrlConfigSwBufferHandling = FALSE
        EthCtrlEnableMii = FALSE
        EthCtrlEnableRxInterrupt = FALSE
        EthCtrlEnableSpiInterface = FALSE
        EthCtrlEnableTxInterrupt = FALSE
        EthCtrlIdx = 1
        EthCtrlMacLayerSpeed = ETH_MAC_LAYER_SPEED_10M
        EthCtrlMacLayerType = ETH_MAC_LAYER_TYPE_XMII
        EthCtrlMacLayerSubType = UNIVERSAL_SERIAL
        EthCtrlPhyAddress = 00:00:5e:00:53:01
        EthCtrlConfigEgress
          EthCtrlConfigEgressFifo:
            EthCtrlConfigEgressFifoBufLenByte = 128
            EthCtrlConfigEgressFifoBufTotal = 100
            EthCtrlConfigEgressFifoIdx = 1
            EthCtrlConfigEgressFifoPriorityAssignment = 7
          EthCtrlConfigScheduler
            EthCtrlConfigSchedulerPredecessor: EthCtrlConfigSchedulerPredecessorOrder=0
          EthCtrlConfigShaper: EthCtrlConfigShaperIdleSlope=1, EthCtrlConfigShaperMaxCredit=2, EthCtrlConfigShaperMinCredit=1
        EthCtrlConfigIngress
          EthCtrlConfigIngressFifo:
            EthCtrlConfigIngressFifoBufLenByte = 128
            EthCtrlConfigIngressFifoBufTotal = 100
            EthCtrlConfigIngressFifoIdx = 1
            EthCtrlConfigIngressFifoPriorityAssignment = 7
        EthCtrlConfigSpiConfiguration:
          EthCtrlConfigSpiChunkPayloadSize = 64
          EthCtrlConfigSpiCommRetries = 1
          EthCtrlConfigSpiCommTimeout = 0.1
          EthCtrlConfigSpiEnableControlDataProtection = FALSE
          EthCtrlConfigSpiEnableRxCSAlign = FALSE
          EthCtrlConfigSpiEnableRxCutThrough = FALSE
          EthCtrlConfigSpiEnableRxZeroAlign = FALSE
          EthCtrlConfigSpiEnableTransmitDataHdrSequence = FALSE
          EthCtrlConfigSpiEnableTxChecksum = FALSE
          EthCtrlConfigSpiEnableTxCutThrough = FALSE
          EthCtrlConfigSpiSelectTimeStamp = FALSE
          EthCtrlConfigSpiTransmitCreditThreshold = 0
          EthCtrlConfigSpiAccessSynchronous = FALSE
          EthCtrlConfigSpiSequenceName = SEQ_ETH_3_BYTE
    EthGeneral:
      EthIndex = 1
      EthDevErrorDetect = FALSE
      EthMainFunctionPeriod = 0.01
      EthGetCounterValuesApi = FALSE
      EthGetRxStatsApi = FALSE
      EthGetTxErrorCounterValuesApi = FALSE
      EthGetTxStatsApi = FALSE
      EthGlobalTimeSupport = FALSE
      EthMaxCtrlsSupported = 2
      EthVersionInfoApi = FALSE
      EthCtrlOffloading:
        EthCtrlEnableOffloadChecksumIPv4 = FALSE
        EthCtrlEnableOffloadChecksumICMP = TRUE
        EthCtrlEnableOffloadChecksumTCP = TRUE
        EthCtrlEnableOffloadChecksumUDP = FALSE
