AUTOSAR XML (schema 4-0-3)
package /Ecuc_RaspberryPi-Pico
  module config Os: ecuc-def-edition=4.2.0, implementation-config-variant=VARIANT-PRE-COMPILE
    3 x OsAppMode:
      OSDEFAULTAPPMODE
      MANUFACT_MODE
      HW_TEST_MODE
    OsOs (OsOS): OsStatus=STANDARD
      OsHooks: OsErrorHook=FALSE, OsPostTaskHook=FALSE, OsPreTaskHook=FALSE, OsShutdownHook=FALSE, OsStartupHook=FALSE, OsProtectionHook=NOT YET SUPPORTED
      OsHookStack: OsHookStackSize=512
      NammaOsekParams (VendorSpecific): OsName=NammaAutosar, CpuName=rp2040, IrqStackSize=512, ContextSaveSize=128, AppTasksSize=3200
    event1 (OsEvent)
    event2 (OsEvent)
    mSecCounter (OsCounter): OsCounterMaxAllowedValue=1000000, OsCounterMinCycle=1, OsCounterTicksPerBase=1, OsCounterType=HARDWARE
    uSecCounter (OsCounter): OsCounterMaxAllowedValue=1000, OsCounterMinCycle=100, OsCounterTicksPerBase=1, OsCounterType=HARDWARE
    RES_MUTEX1 (OsResource): OsResourceProperty=STANDARD
    5 x OsTask, all with OsTaskStackSize=512, OsTaskSchedule=NON:
      Task_A: OsTaskActivation=2, OsTaskPriority=1, OsTaskResourceRef=RES_MUTEX1
        OsTaskAutostart: OsTaskAppModeRef=OSDEFAULTAPPMODE, OsTaskAppModeRef=MANUFACT_MODE, OsTaskAppModeRef=HW_TEST_MODE
      Task_B: OsTaskActivation=1, OsTaskPriority=2, OsTaskEventRef=event1
      Task_C: OsTaskActivation=1, OsTaskPriority=3, OsTaskEventRef=event1, OsTaskEventRef=event2
        OsTaskAutostart: OsTaskAppModeRef=OSDEFAULTAPPMODE
      Task_D: OsTaskActivation=1, OsTaskPriority=4, OsTaskResourceRef=RES_MUTEX1
      EcuM_StartupTwo: OsTaskActivation=1, OsTaskPriority=100
        OsTaskAutostart: OsTaskAppModeRef=OSDEFAULTAPPMODE
    4 x OsAlarm:
      WakeTaskA: OsAlarmCounterRef=mSecCounter
        OsAlarmAction
          ACTIVATETASK (OsAlarmActivateTask): OsAlarmActivateTaskRef=Task_A
        OsAlarmAutostart:
          OsAlarmAlarmTime = 40
          OsAlarmCycleTime = 500
          OsAlarmAutostartType = NOT YET SUPPORTED
          OsAlarmAppModeRef = OSDEFAULTAPPMODE
          OsAlarmAppModeRef = MANUFACT_MODE
      WakeTaskB: OsAlarmCounterRef=mSecCounter
        OsAlarmAction
          SETEVENT (OsAlarmSetEvent): OsAlarmSetEventTaskRef=Task_B, OsAlarmSetEventRef=event1
      uSecAlarm: OsAlarmCounterRef=uSecCounter
        OsAlarmAction
          ALARMCALLBACK (OsAlarmCallback): OsAlarmCallbackName=Alarm_uSecAlarm_callback
      WakeTaskD: OsAlarmCounterRef=mSecCounter
        OsAlarmAction
          ACTIVATETASK (OsAlarmActivateTask): OsAlarmActivateTaskRef=Task_D
        OsAlarmAutostart: OsAlarmAlarmTime=40, OsAlarmCycleTime=1000, OsAlarmAutostartType=NOT YET SUPPORTED, OsAlarmAppModeRef=OSDEFAULTAPPMODE
    SystemTickISR (OsIsr): OsIsrInterruptNumber=4, OsIsrInterruptPriority=0, OsIsrCategory=2, OsIsrStackSize=
  module config Mcu: ecuc-def-edition=4.2.0, implementation-config-variant=VARIANT-PRE-COMPILE
    McuNammaAutosarInfo (VendorSpecific): Micro=rp2040, MicroArch=cortex-m0, MicroMaker=RaspberryPi
  module config Port: ecuc-def-edition=4.2.0, implementation-config-variant=VARIANT-PRE-COMPILE
    PortConfigSet
      PortContainer: PortNumberOfPortPins=2
        PortPin:
          PortPinId = 25
          PortPinDirection = PORT_PIN_OUT
          PortPinDirectionChangeable = FALSE
          PortPinLevelValue = PORT_PIN_LEVEL_LOW
          PortPinMode = PORT_PIN_MODE_DIO
          PortPinModeChangeable = FALSE
          PortPinInitialMode = PORT_PIN_MODE_DIO
        PortPin:
          PortPinId = 65535
          PortPinDirection = PORT_PIN_IN
          PortPinDirectionChangeable = FALSE
          PortPinLevelValue = PORT_PIN_LEVEL_LOW
          PortPinMode = PORT_PIN_MODE_DIO
          PortPinModeChangeable = FALSE
          PortPinInitialMode = PORT_PIN_MODE_DIO
  module config Dio: ecuc-def-edition=4.2.0, implementation-config-variant=VARIANT-PRE-COMPILE
    DioConfig
      DioPort: DioPortId=25
        DioChannel: DioChannelId=25
      DioPort: DioPortId=65535
        DioChannel: DioChannelId=35
        DioChannelGroup: DioChannelGroupIdentification=ChGrp_, DioPortOffset=e.g., 0x4, DioPortMask=e.g., 0xF0F
    DioGeneral: DioDevErrorDetect=FALSE, DioVersionInfoApi=FALSE, DioFlipChannelApi=FALSE, DioMaskedWritePortApi=FALSE
