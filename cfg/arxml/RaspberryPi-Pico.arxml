AUTOSAR XML (schema 4-0-3)
package /Ecuc_RaspberryPi-Pico
  module config Os: ecuc-def-edition=4.2.0, implementation-config-variant=VARIANT-PRE-COMPILE
    3 x OsAppMode:
      OSDEFAULTAPPMODE
      MANUFACT_MODE
      HW_TEST_MODE
    OsOs (OsOS): OsStatus=STANDARD
      OsHooks: OsErrorHook=FALSE, OsPostTaskHook=FALSE, OsPreTaskHook=FALSE, OsShutdownHook=FALSE, OsStartupHook=FALSE, OsProtectionHook=NOT YET SUPPORTED
      OsHookStack: OsHookStackSize=512
      NammaOsekParams (VendorSpecific): OsName=NammaAutosar, CpuName=rp2040, IrqStackSize=512, ContextSaveSize=128, AppTasksSize=3200
    event1 (OsEvent)
    event2 (OsEvent)
    mSecCounter (OsCounter): OsCounterMaxAllowedValue=1000000, OsCounterMinCycle=1, OsCounterTicksPerBase=1, OsCounterType=HARDWARE
    uSecCounter (OsCounter): OsCounterMaxAllowedValue=1000, OsCounterMinCycle=100, OsCounterTicksPerBase=1, OsCounterType=HARDWARE
    RES_MUTEX1 (OsResource): OsResourceProperty=STANDARD
    5 x OsTask, all with OsTaskStackSize=512, OsTaskSchedule=NON:
      Task_A: OsTaskActivation=2, OsTaskPriority=1, OsTaskResourceRef=RES_MUTEX1
        OsTaskAutostart: OsTaskAppModeRef=OSDEFAULTAPPMODE, OsTaskAppModeRef=MANUFACT_MODE, OsTaskAppModeRef=HW_TEST_MODE
      Task_B: OsTaskActivation=1, OsTaskPriority=2, OsTaskEventRef=event1
      Task_C: OsTaskActivation=1, OsTaskPriority=3, OsTaskEventRef=event1, OsTaskEventRef=event2
        OsTaskAutostart: OsTaskAppModeRef=OSDEFAULTAPPMODE
      Task_D: OsTaskActivation=1, OsTaskPriority=4, OsTaskResourceRef=RES_MUTEX1
      EcuM_StartupTwo: OsTaskActivation=1, OsTaskPriority=100
        OsTaskAutostart: OsTaskAppModeRef=OSDEFAULTAPPMODE
    4 x OsAlarm:
      WakeTaskA: OsAlarmCounterRef=mSecCounter
        OsAlarmAction
          ACTIVATETASK (OsAlarmActivateTask): OsAlarmActivateTaskRef=Task_A
        OsAlarmAutostart:
          OsAlarmAlarmTime = 40
          OsAlarmCycleTime = 500
          OsAlarmAutostartType = NOT YET SUPPORTED
          OsAlarmAppModeRef = OSDEFAULTAPPMODE
          OsAlarmAppModeRef = MANUFACT_MODE
      WakeTaskB: OsAlarmCounterRef=mSecCounter
        OsAlarmAction
          SETEVENT (OsAlarmSetEvent): OsAlarmSetEventTaskRef=Task_B, OsAlarmSetEventRef=event1
      uSecAlarm: OsAlarmCounterRef=uSecCounter
        OsAlarmAction
          ALARMCALLBACK (OsAlarmCallback): OsAlarmCallbackName=Alarm_uSecAlarm_callback
      WakeTaskD: OsAlarmCounterRef=mSecCounter
        OsAlarmAction
          ACTIVATETASK (OsAlarmActivateTask): OsAlarmActivateTaskRef=Task_D
        OsAlarmAutostart: OsAlarmAlarmTime=40, OsAlarmCycleTime=1000, OsAlarmAutostartType=NOT YET SUPPORTED, OsAlarmAppModeRef=OSDEFAULTAPPMODE
    SystemTickISR (OsIsr): OsIsrInterruptNumber=4, OsIsrInterruptPriority=0, OsIsrCategory=2, OsIsrStackSize=
  module config Mcu: ecuc-def-edition=4.2.0, implementation-config-variant=VARIANT-PRE-COMPILE
    McuNammaAutosarInfo (VendorSpecific): Micro=rp2040, MicroArch=cortex-m0, MicroMaker=RaspberryPi
  module config Port: ecuc-def-edition=4.2.0, implementation-config-variant=VARIANT-PRE-COMPILE
    PortConfigSet
      PortContainer: PortNumberOfPortPins=1
        PortPin:
          PortPinId = 25
          PortPinDirection = PORT_PIN_OUT
          PortPinDirectionChangeable = FALSE
          PortPinLevelValue = PORT_PIN_LEVEL_LOW
          PortPinMode = PORT_PIN_MODE_DIO
          PortPinModeChangeable = FALSE
          PortPinInitialMode = PORT_PIN_MODE_DIO
    PortGeneral: PortDevErrorDetect=TRUE, PortVersionInfoApi=FALSE, PortSetPinDirectionApi=TRUE, PortSetPinModeApi=FALSE
  module config Dio: ecuc-def-edition=4.2.0, implementation-config-variant=VARIANT-PRE-COMPILE
    DioConfig
      DioPort: DioPortId=25
        DioChannel: DioChannelId=25
        DioChannelGroup: DioChannelGroupIdentification=ChGrp_test, DioPortOffset=0x4, DioPortMask=0xF0F
    DioGeneral: DioDevErrorDetect=FALSE, DioVersionInfoApi=TRUE, DioFlipChannelApi=FALSE, DioMaskedWritePortApi=TRUE
  module config Spi: ecuc-def-edition=4.2.0, implementation-config-variant=VARIANT-PRE-COMPILE
    SpiDriver: SpiMaxChannel=3, SpiMaxJob=3, SpiMaxSequence=2
      3 x SpiChannel, all with SpiChannelType=IB, SpiDataWidth=4, SpiEbMaxLength=, SpiIbNBuffers=65535, SpiTransferStart=MSB:
        SpiChannel: SpiChannelId=0, SpiDefaultData=0xAA551234458a45b3876190
        SpiChannel: SpiChannelId=1, SpiDefaultData=1234567890
        SpiChannel: SpiChannelId=2, SpiDefaultData=0xAA551234
      SpiExternalDevice:
        SpiBaudrate = 1000000.0
        SpiCsIdentifier = CS_Ethernet
        SpiCsPolarity = LOW
        SpiCsSelection = CS_VIA_PERIPHERAL_ENGINE
        SpiDataShiftEdge = LEADING
        SpiEnableCs = FALSE
        SpiHwUnit = CSIB0
        SpiShiftClockIdleLevel = LOW
        SpiTimeClk2Cs = 0.0
        SpiTimeCs2Clk = 0.000001
        SpiTimeCs2Cs = 0.000001
      3 x SpiJob, all with SpiJobEndNotification=NULL, SpiDeviceAssignment=CSIB0:
        SpiJob: SpiJobId=0, SpiJobPriority=0
          SpiChannelList: SpiChannelIndex=0, SpiChannelAssignment=Job no: 0
          SpiChannelList: SpiChannelIndex=2, SpiChannelAssignment=Job no: 0
        SpiJob: SpiJobId=1, SpiJobPriority=1
          SpiChannelList: SpiChannelIndex=1, SpiChannelAssignment=Job no: 1
        SpiJob: SpiJobId=2, SpiJobPriority=3
          SpiChannelList: SpiChannelIndex=2, SpiChannelAssignment=Job no: 2
      SpiSequence: SpiInterruptibleSequence=FALSE, SpiSeqEndNotification=e.g: SeqEndNotificationFunc, SpiSequenceId=0
        SpiJobAssignment: SpiJob=0
      SpiSequence: SpiInterruptibleSequence=FALSE, SpiSeqEndNotification=e.g: SeqEndNotificationFunc, SpiSequenceId=1
        SpiJobAssignment: SpiJob=1
        SpiJobAssignment: SpiJob=2
    SpiGeneral:
      SpiCancelApi = FALSE
      SpiChannelBuffersAllowed = IB
      SpiDevErrorDetect = FALSE
      SpiHwStatusApi = FALSE
      SpiInterruptibleSeqAllowed = FALSE
      SpiLevelDelivered = 1
      SpiMainFunctionPeriod = 0.01
      SpiSupportConcurrentSyncTransmit = FALSE
      SpiVersionInfoApi = FALSE
    SpiPublishedInformation: SpiMaxHwUnit=1
